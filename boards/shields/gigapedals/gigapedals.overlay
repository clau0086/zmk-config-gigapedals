/ {
    chosen {
        zmk,kscan = &default_kscan;
    };

    default_kscan: kscan {
        compatible = "zmk,kscan-gpio-direct";
        label = "default_kscan";

        input-gpios =
            <&xiao_d 6 (GPIO_ACTIVE_HIGH | GPIO_PULL_UP)>,
            <&xiao_d 11 (GPIO_ACTIVE_HIGH | GPIO_PULL_UP)>,

    };

};
